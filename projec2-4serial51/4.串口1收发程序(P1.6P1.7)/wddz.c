/********************************************************************
                           伟达电子工作室

实现功能:基于STC15W4K48S4单片机四串口开发板之串口收发程序
使用芯片：STC15W4K48S4
晶振：11.0592MHZ
波特率：9600(有无校验位：无；数据位：8；停止位：1；)
数据格式：无
编译环境：Keil4
作者：fenglongmeng	
qq 490022104 CALL18003710439
网站：wddz.taobao.com
【声明】此程序仅用于学习与参考，引用请注明版权和作者信息！     

*********************************************************************/
/********************************************************************
                           功能说明（串口1通讯   P1.6/P1.7）

PC发送0xff，单片机灯全亮;单片机向PC发送0xAA;
PC发送0x00，单片机灯全灭;单片机向PC发送0xBB;
PC发送0x01，单片机第1路灯亮;单片机向PC发送0xA1;
PC发送0x02，单片机第2路灯亮;单片机向PC发送0xA2;
PC发送0x03，单片机第3路灯亮;单片机向PC发送0xA3;
PC发送0x04，单片机第4路灯亮;单片机向PC发送0xA4;

PC发送0xf1，单片机第1路灯灭;单片机向PC发送0xB1;
PC发送0xf2，单片机第2路灯灭;单片机向PC发送0xB2;
PC发送0xf3，单片机第3路灯灭;单片机向PC发送0xB3;
PC发送0xf4，单片机第4路灯灭;单片机向PC发送0xB4;
*********************************************************************/

#include"STC15Fxxxx.H"
#include <intrins.h>	  //用nop函数延时的头文件
#include"Init_IO.h" 
#define uchar unsigned char//宏定义无符号字符型
#define uint unsigned int //宏定义无符号整型
#define S1_S0 0x40
#define S1_S1 0x80
void SendString(char *s);

/********************************************************************
                            初始定义
*********************************************************************/

uchar tab[]={"wddz.taobao.com\n"};  
uchar dat=0xee;
/********************************************************************
                            延时函数
*********************************************************************/
void Delay30ms()		//@11.0592MHz
{
	unsigned char i, j, k;

	i = 2;
	j = 67;
	k = 183;
	do
	{
		do
		{
			while (--k);
		} while (--j);
	} while (--i);
}

/********************************************************************
                            串口初始化
*********************************************************************/

void UartInit(void)		//9600bps@11.0592MHz
{

    P_SW1&=~(S1_S0);  //将串口一切换至P1.6和P1.7
	P_SW1|=(S1_S1);	  //将串口一切换至P1.6和P1.7

	SCON = 0x50;		//8位数据,可变波特率
	AUXR |= 0x40;		//定时器1时钟为Fosc,即1T
	AUXR &= 0xFE;		//串口1选择定时器1为波特率发生器
	TMOD &= 0x0F;		//设定定时器1为16位自动重装方式
	TL1 = 0xE0;		//设定定时初值
	TH1 = 0xFE;		//设定定时初值
	ET1 = 0;		//禁止定时器1中断
	TR1 = 1;		//启动定时器1
    
    
	ES=1;		//开串口中断	    
 	EA=1; 		//开总中断    
}
/********************************************************************
                            发送一个字节
*********************************************************************/
void  Send(uchar x)
 {

    SBUF = x;
  	while(!TI);
	TI=0;

 }
/********************************************************************
                            发送一个字符串
*********************************************************************/
void  SendString(uchar *x)
 {

  while(*x)   
  {
    SBUF = *x++;
  	while(!TI);
	TI=0;
  }
  Delay30ms();   

     
 }
/********************************************************************
                            发送一个 数组16位
*********************************************************************/ 

void SendArray(uchar x[]) 

{
    uchar i;
        for( i=0;i<16;i++ )
           {
            Send(x[i]);
            Delay30ms();
           }
  
} 
/********************************************************************
                            串口缓存清理
*********************************************************************/ 
void CLR_Buf(void)                           
{
   dat=' ';                   
}    
/********************************************************************
                            发送接收中断函数
*********************************************************************/

void uart_isr()  interrupt 4 
{
	if( RI ) RI = 0;
	dat = SBUF;
	if( TI ) {TI = 0;}

}

/********************************************************************
                            主函数
*********************************************************************/

void main()
{

	P0M1 = 0;	P0M0 = 0;	//设置为准双向口
	P1M1 = 0;	P1M0 = 0;	//设置为准双向口
	P2M1 = 0;	P2M0 = 0;	//设置为准双向口
	P3M1 = 0;	P3M0 = 0;	//设置为准双向口
	P4M1 = 0;	P4M0 = 0;	//设置为准双向口
	P5M1 = 0;	P5M0 = 0;	//设置为准双向口
	P6M1 = 0;	P6M0 = 0;	//设置为准双向口
	P7M1 = 0;	P7M0 = 0;	//设置为准双向口

	UartInit();
   SendString("CALL:18003710439\n");
   SendString("QQ:490022104\n");
   SendArray(tab);CLR_Buf();
    while(1)
    {
            if(dat==0xff){OUT01=OUT02=OUT03=OUT04=0;Send(0xAA);CLR_Buf();}
            if(dat==0x00){OUT01=OUT02=OUT03=OUT04=1;Send(0xBB);CLR_Buf();}   
            if(dat==0x01){OUT01=0;Send(0xA1);CLR_Buf();}
            if(dat==0x02){OUT02=0;Send(0xA2);CLR_Buf();} 
			if(dat==0x03){OUT03=0;Send(0xA3);CLR_Buf();}
			if(dat==0x04){OUT04=0;Send(0xA4);CLR_Buf();}

            if(dat==0xf1){OUT01=1;Send(0xB1);CLR_Buf();}
            if(dat==0xf2){OUT02=1;Send(0xB2);CLR_Buf();} 
			if(dat==0xf3){OUT03=1;Send(0xB3);CLR_Buf();}
			if(dat==0xf4){OUT04=1;Send(0xB4);CLR_Buf();}  
			          
    }            
			
}





